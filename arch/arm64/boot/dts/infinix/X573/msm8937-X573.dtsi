#include "msm8937-X573-camera.dtsi"
#include "msm8937-X573-i2c.dtsi"
#include "msm8937-X573-mdss.dtsi"
#include "msm8937-X573-pinctrl.dtsi"
#include "msm8937-X573-regulator.dtsi"
#include "msm8937-X573-sound.dtsi"
#include "msm8937-X573-spmi.dtsi"
